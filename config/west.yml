## config/west.yml
```yaml
manifest:
  defaults:
    # Pinned to v0.3.0 (2025-08-01): ZMK main has an unfixed BLE wake regression
    # for the split central half (zmkfirmware/zmk#3207, Zephyr 4.1). v0.3.0 still
    # has physical-layouts + pointing, which this shield/keymap need.
    revision: v0.3.0
  remotes:
    - name: zmkfirmware
      url-base: https://github.com/zmkfirmware
    # Additional modules containing boards/shields/custom code can be listed here as well
    # See https://docs.zephyrproject.org/3.2.0/develop/west/manifest.html#projects
  projects:
    - name: zmk
      remote: zmkfirmware
      import: app/west.yml
  self:
    path: config
```
